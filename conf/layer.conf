## conf/layer.conf
```bitbake
# We have a conf and classes directory, add to BBPATH
BBPATH .= ":${LAYERDIR}"

# We have a packages directory, add to BBFILES
BBFILES += "${LAYERDIR}/recipes-*/*/*.bb \
            ${LAYERDIR}/recipes-*/*/*.bbappend"

BBFILE_COLLECTIONS += "droi-fsl-release"
BBFILE_PATTERN_droi-fsl-release := "^${LAYERDIR}"
BBFILE_PRIORITY_droi-fsl-release = "8"
```
